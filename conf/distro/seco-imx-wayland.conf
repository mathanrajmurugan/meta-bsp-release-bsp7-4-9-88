## conf/distro/seco-imx-wayland.conf
```bitbake
# i.MX DISTRO for Wayland without X11

include conf/distro/include/seco-imx-base.inc
include conf/distro/include/seco-imx-preferred-env.inc

DISTRO = "seco-imx-wayland"

# Remove conflicting backends
DISTRO_FEATURES_remove = "directfb x11 "
DISTRO_FEATURES_append = " wayland pam systemd"
```

## conf/distro/seco-imx-x11.conf
```bitbake
# i.MX DISTRO for X11 with no wayland

include conf/distro/include/seco-imx-base.inc
include conf/distro/include/seco-imx-preferred-env.inc

DISTRO = "seco-imx-x11"

# Remove conflicting backends.
DISTRO_FEATURES_remove = "wayland"

# These are X11 specific
DISTRO_FEATURES_append = " x11"
```

## conf/layer.conf
```bitbake
# Let bitbake find our .bbclass and .conf files
BBPATH .= ":${LAYERDIR}"

# Let bitbake know where to look for .bb and .bbappend files
BBFILES += "${LAYERDIR}/recipes-*/*/*.bb \
            ${LAYERDIR}/recipes-*/*/*.bbappend"

BBFILE_COLLECTIONS +="seco-bsp-release-bsp7-rel"
BBFILE_PATTERN_seco-bsp-release-bsp7-rel = "^${LAYERDIR}/"
BBFILE_PRIORITY_seco-bsp-release-bsp7-rel = "8"
```

## conf/machine/seco-imx6-962.conf
```bitbake
#@TYPE: Machine
#@NAME: seco-imx6
#@SOC: i.MX6Q/D/DL/S
#@DESCRIPTION: Machine configuration for SECO imx6-962

MACHINEOVERRIDES =. "mx6:mx6dl:mx6q:"

require conf/machine/include/imx-base.inc
require conf/machine/include/tune-cortexa9.inc

PREFERRED_PROVIDER_u-boot = "u-boot-seco"
PREFERRED_PROVIDER_u-boot_mx6 = "u-boot-seco"
PREFERRED_PROVIDER_virtual/bootloader = "u-boot-seco"
PREFERRED_PROVIDER_virtual/bootloader_mx6 = "u-boot-seco"

UBOOT_MAKE_TARGET = " "
UBOOT_SUFFIX= "img"
SPL_BINARY = "SPL"
UBOOT_MACHINE = "mx6qdl_seco_uQ7_962_2G_1G_2x256M_defconfig "

PREFERRED_PROVIDER_virtual/kernel ?= "linux-seco"
PREFERRED_PROVIDER_virtual/kernel_mx6 = "linux-seco"

KERNEL_DEVICETREE ?= "imx6q-seco_uq7_962.dtb imx6dl-seco_uq7_962.dtb"

KERNEL_IMAGETYPE = "zImage"

SERIAL_CONSOLE = "115200 ttymxc1"
```
